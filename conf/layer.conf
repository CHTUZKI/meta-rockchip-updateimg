## conf/layer.conf
```bitbake
BBPATH .= ":${LAYERDIR}"

BBFILES += "${LAYERDIR}/recipes-*/*/*.bb \
            ${LAYERDIR}/recipes-*/*/*.bbappend"

BBFILE_COLLECTIONS += "rockchip-updateimg"
BBFILE_PATTERN_rockchip-updateimg = "^${LAYERDIR}/"
BBFILE_PRIORITY_rockchip-updateimg = "6"

LAYERSERIES_COMPAT_rockchip-updateimg = "kirkstone langdale mickledore nanbield scarthgap styhead walnascar"
```
